## CMakeLists.txt
```
cmake_minimum_required(VERSION 3.13.1)

set(DTC_OVERLAY_FILE "${CMAKE_CURRENT_SOURCE_DIR}/dts/stm32f7.overlay.dts")
include_directories(include)

include($ENV{ZEPHYR_BASE}/cmake/app/boilerplate.cmake NO_POLICY_SCOPE)
project(base)

# set(CMAKE_C_FLAGS "${CMAKE_C_FLAGS} -DUSE_FULL_LL_DRIVER")
# add_definitions(-DUSE_FULL_LL_DRIVER)

add_subdirectory(drivers)

# include(test.cmake)

# Application
FILE(
	GLOB_RECURSE app_sources
	sys/*.c
	src/main.c
	tests/kernel/mem_protect/userspace/*.c
	src/encoder_run.c
	# src/test_esp32_uart.c
	# drivers/wifi/esp32_core.c
	# src/test_esp32_spi.c
	# src/test_pwm.c
	# src/device_list.c
	# src/test_spi.c
	# src/test_base.c
	# src/test_thread.c
	# src/test_thread_wrap.c
	# src/test_asm.c
)

target_sources(app PRIVATE ${app_sources})
```

## Kconfig
```
source "Kconfig.zephyr"

menu "Small Car Options"

config SMALL_CAR
	bool "car config"
	select USE_STM32_LL_UTILS
	select USE_STM32_LL_GPIO
	select USE_STM32_LL_TIM
	select USE_STM32_LL_USART

if SMALL_CAR

config SMALL_CAR_ENCODER_NAME
	string "small car encoder name"
	default "small_car_encoder"

config SMALL_CAR_ENCODER_PSC
	int "small car encoder psc"
	default 0

config SMALL_CAR_ENCODER_ARR
	int "small car encoder arr"
	default 10799

endif # SMALL_CAR

endmenu
```

## prj.conf
```kconfig
# Shell
CONFIG_SHELL=y

# Uart
CONFIG_UART_1=n
CONFIG_UART_2=y
CONFIG_UART_6=n


# Log
CONFIG_LOG=y
# CONFIG_LOG_PRINTK=y


# System reset
CONFIG_REBOOT=y


# Debug
CONFIG_DEBUG=y


# Stm32 Library
# CONFIG_HAS_STM32CUBE=y
# CONFIG_USE_STM32_LL_TIM=y
# CONFIG_USE_STM32_LL_GPIO=y


# Monitor
CONFIG_THREAD_NAME=y
# CONFIG_THREAD_MONITOR=y
CONFIG_KERNEL_SHELL=y
CONFIG_DEVICE_SHELL=y
CONFIG_INIT_STACKS=y
CONFIG_THREAD_STACK_INFO=y


# Application Config
CONFIG_APPLICATION_DEFINED_SYSCALL=y
CONFIG_DYNAMIC_INTERRUPTS=y


# Userspace
CONFIG_ARM_MPU=y
CONFIG_USERSPACE=y


# Test Userspace
CONFIG_ZTEST=y
CONFIG_INIT_STACKS=y
CONFIG_APPLICATION_DEFINED_SYSCALL=y
CONFIG_THREAD_USERSPACE_LOCAL_DATA=y
CONFIG_TEST_USERSPACE=y


# For PM test
# CONFIG_SYS_POWER_MANAGEMENT=n
# CONFIG_SYS_POWER_LOW_POWER_STATE=y
# CONFIG_SYS_POWER_DEEP_SLEEP=y
# CONFIG_DEVICE_POWER_MANAGEMENT=y
# CONFIG_MAIN_STACK_SIZE=4096
# CONFIG_IDLE_STACK_SIZE=1024


# CONFIG_SPI=y
# CONFIG_SPI_2=n
# CONFIG_SPI_3=y
# CONFIG_SPI_LOG_LEVEL_DBG=y


# car config
CONFIG_SMALL_CAR=y


# config esp32 wifi with uart_1
# CONFIG_WIFI_ESP32=y
# CONFIG_WIFI_ESP32_UART_DEVICE="UART_1"


# CONFIG_MODEM=y
# CONFIG_MODEM_RECEIVER=y
# CONFIG_NETWORKING=y
# CONFIG_NET_OFFLOAD=y
# CONFIG_NET_SOCKETS=y
# CONFIG_NET_LOG=y
# CONFIG_NET_OFFLOAD_LOG_LEVEL_DBG=y
# CONFIG_NET_SOCKETS_POSIX_NAMES=y
# CONFIG_WIFI=y
# CONFIG_WIFI_OFFLOAD=y
# CONFIG_NET_IPV4=y
# CONFIG_NET_IPV6=n
# CONFIG_NET_IF_MAX_IPV4_COUNT=2

# CONFIG_MODEM_WNCM14A2A=y
```

## dts/stm32f7.overlay.dts
```dts
/ {
	chosen {
		zephyr,console = &usart2;
		zephyr,shell-uart = &usart2;
		zephyr,sram = &sram0;
		zephyr,flash = &flash0;
	};
};

&usart2 {
	current-speed = <115200>;
	pinctrl-names = "default";
	status = "okay";
};
```

## src/main.c
```c
#include "main.h"

#if CONFIG_ZTEST
void test_main(void)
#else
void main(void)
#endif
{
	test_userspace();
}
```

## include/timer_encoder.h
```c
#pragma once

#include <device.h>

#include <stm32f7xx_ll_tim.h>
#include <stm32f7xx_ll_gpio.h>

#define ENCODER_NAME_1	"encoder_1"
#define PWM_PSC		0
#define PWM_ARR		10799

#ifdef __cplusplus
extern "C" {
#endif


/* -----------------------define car wheels----------------------- */

enum wheel_type {
	WheelLeftFront = 0,
	WheelLeftBack,
	WheelRightFront,
	WheelRightBack
};

typedef enum wheel_type wheel_t;

/** -----------------------PWM Encoder driver API definition---------------------- */
typedef int (*encoder_start_t)();
typedef int (*encoder_stop_t)();
typedef uint32_t (*encoder_get_counter_t)();
typedef int (*encoder_setPwm_t)(wheel_t wheel, uint16_t pwm_a, uint16_t pwm_b);

struct encoder_api_t {
	encoder_start_t start;
	encoder_stop_t stop;
	encoder_get_counter_t getCounter;
	encoder_setPwm_t setPwm;
};


/* -----------------------define syscalls----------------------- */

__syscall int encoder_start(struct device *dev);

static inline int z_impl_encoder_start(struct device *dev)
{
	const struct encoder_api_t *api = (const struct encoder_api_t *)dev->driver_api;
	return api->start();
}

__syscall int encoder_stop(struct device *dev);

static inline int z_impl_encoder_stop(struct device *dev)
{
	const struct encoder_api_t *api = (const struct encoder_api_t *)dev->driver_api;
	return api->stop();
}

__syscall uint32_t encoder_getCounter(struct device *dev);

static inline uint32_t z_impl_encoder_getCounter(struct device *dev)
{
	const struct encoder_api_t *api = (const struct encoder_api_t *)dev->driver_api;
	return api->getCounter();
}

__syscall int encoder_setPwm(const struct device* dev, wheel_t wheel, uint16_t pwm_a, uint16_t pwm_b);

static inline int z_impl_encoder_setPwm(const struct device* dev, wheel_t wheel, uint16_t pwm_a, uint16_t pwm_b)
{
	const struct encoder_api_t *api = (const struct encoder_api_t *)dev->driver_api;
	return api->setPwm(wheel, pwm_a, pwm_b);
}

#ifdef __cplusplus
}
#endif

#include <syscalls/timer_encoder.h>
```

## src/encoder_run.c
```c
#include <zephyr.h>
#include <device.h>
#include <logging/log.h>
#include <timer_encoder.h>
#include <soc.h>

#define WHEEL_PWM_MAX	PWM_ARR

LOG_MODULE_REGISTER(encoder_run, 4);

static void monitor_task(void *p1, void *p2, void *p3)
{
	struct device* encoder_dev = device_get_binding(ENCODER_NAME_1);
	if (encoder_dev != NULL) {
		LOG_INF("Executing device_get_binding successed");
	} else {
		LOG_ERR("Executing device_get_binding failed");
		return;
	}
	volatile uint32_t counter = 0;
	while(1) {
		counter = encoder_getCounter(encoder_dev);
		LOG_INF("counter: %u", counter);
		k_sleep(200);
	}
}

static void encode_task(void *p1, void *p2, void *p3)
{
	struct device* encoder_dev = device_get_binding(ENCODER_NAME_1);
	if (encoder_dev != NULL) {
		LOG_INF("Executing device_get_binding successed");
	} else {
		LOG_ERR("Executing device_get_binding failed");
		return;
	}

	int16_t  pwm_a = 0, pwm_b = WHEEL_PWM_MAX;
	int8_t pwm_a_direction = 1, pwm_b_direction = -1;

	while(1) {

		LOG_INF("set pwm_a: %d, pwm_b: %d\n", pwm_a, pwm_b);

		pwm_a = 1000;
		pwm_b = WHEEL_PWM_MAX;

		encoder_setPwm(encoder_dev, WheelLeftBack, pwm_a, pwm_b);

		k_sleep(500);

		pwm_a = 10000;
		pwm_b = WHEEL_PWM_MAX;

		encoder_setPwm(encoder_dev, WheelLeftBack, pwm_a, pwm_b);

		k_sleep(500);

		pwm_a = WHEEL_PWM_MAX;
		pwm_b = 1000;

		encoder_setPwm(encoder_dev, WheelLeftBack, pwm_a, pwm_b);

		k_sleep(500);

		pwm_a = WHEEL_PWM_MAX;
		pwm_b = 10000;

		encoder_setPwm(encoder_dev, WheelLeftBack, pwm_a, pwm_b);

		k_sleep(500);

		pwm_a = WHEEL_PWM_MAX;
		pwm_b = WHEEL_PWM_MAX;

		encoder_setPwm(encoder_dev, WheelLeftBack, pwm_a, pwm_b);

		k_sleep(500);

		// pwm_a += 5000 * pwm_a_direction;

		// if (pwm_a > WHEEL_PWM_MAX) {
		// 	pwm_a_direction = -1;
		// 	pwm_a = WHEEL_PWM_MAX;
		// } else if (pwm_a < 0) {
		// 	pwm_a_direction = 1;
		// 	pwm_a = 0;
		// }

		// pwm_b += 100 * pwm_b_direction;

		// if (pwm_b > WHEEL_PWM_MAX) {
		// 	pwm_b_direction = -1;
		// 	pwm_b = WHEEL_PWM_MAX;
		// } else if (pwm_b < 0) {
		// 	pwm_b_direction = 1;
		// 	pwm_b = 0;
		// }

		// k_sleep(5000);
	}
}

// K_THREAD_DEFINE(monitor_thread, 512, monitor_task, NULL, NULL, NULL, 0, 0, K_NO_WAIT);
// K_THREAD_DEFINE(encode_thread, 512, encode_task, NULL, NULL, NULL, 0, 0, K_NO_WAIT);
```
